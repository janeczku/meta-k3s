## conf/layer.conf
```bitbake
# We have a conf and classes directory, add to BBPATH
BBPATH .= ":${LAYERDIR}"

# We have recipes-* directories, add to BBFILES
BBFILES += "${LAYERDIR}/recipes-*/*/*.bb \
	${LAYERDIR}/recipes-*/*/*.bbappend"

BBFILE_COLLECTIONS += "meta-k3s"
BBFILE_PATTERN_meta-k3s = "^${LAYERDIR}/"
BBFILE_PRIORITY_meta-k3s = "10"

LAYERSERIES_COMPAT_meta-yoe = "sumo thud warrior"
```
